/*@!Encoding:1252*/
includes
{


}

variables
{
  message ENGINE_CONTROL ECmsg;
  int button = 0x00;
  msTimer delay;
  int i, SetSpeed, SetGear, SignButton;
  float TempDistance, SetDistance;
  
}

//on key 'x'
//{
//  SetMediaFile("Panel1", "Media Player", "C:\\Users\\Training\\Downloads\\Audio.mp3");
//  write("Pressed");
//  putValue(Speaker, 1);
//}

on sysvar ENGINE_CONTROL::StartStopButton
{
  //SetClockControlTime("Clock Control", "ClockCAPL", 10, 20, 30);
  ECmsg.StartStop ^= 0x01;
  button ^= 0x01;
  @ENGINE_CONTROL::FuelLevel = 100;
  ECmsg.Fuel = @ENGINE_CONTROL::FuelLevel;
  if (button == 0x00)
  {
    ECmsg.Speed = 0;
    @ENGINE_CONTROL::SpeedGauge = 0;
    @ENGINE_CONTROL::AcceleratorTrackbar = 0;
    @ENGINE_CONTROL::AccGauge = 0;
    @ENGINE_CONTROL::BrakeTrackbar = 0;
    @ENGINE_CONTROL::BrakeGauge = 0;
    @ENGINE_CONTROL::GearTrackbar = 0;
    @ENGINE_CONTROL::FuelLED = 0;
    @ENGINE_CONTROL::GearDisplay = 0;
    @ENGINE_CONTROL::Distance = 0;
  }
  output(ECmsg);  
}

on sysvar ENGINE_CONTROL::GearTrackbar
{
  if (button == 0x01)
  {    
  ECmsg.Gear = @ENGINE_CONTROL::GearTrackbar;
  @ENGINE_CONTROL::GearDisplay = ECmsg.Gear;
  output(ECmsg);
  }
}

on sysvar ENGINE_CONTROL::AcceleratorTrackbar
{
  if (button == 0x01)
  {
  ECmsg.Gear = @ENGINE_CONTROL::GearTrackbar;
  ECmsg.Accelerator = @ENGINE_CONTROL::AcceleratorTrackbar;
  if (ECmsg.Gear == 0)
  {
    SignButton = 0;
    ECmsg.Accelerator = 0;
    @ENGINE_CONTROL::AccGauge = 0;
    @ENGINE_CONTROL::SpeedGauge = 0;
  }
  else if (SignButton == 1 && @ENGINE_CONTROL::Distance <= (TempDistance + SetDistance))
  {
    @ENGINE_CONTROL::SpeedGauge = (SetSpeed/8) * @ENGINE_CONTROL::AcceleratorTrackbar;
    @ENGINE_CONTROL::AccGauge = @ENGINE_CONTROL::AcceleratorTrackbar;
    @ENGINE_CONTROL::Distance += 0.02;
    write("1 block");
  }
  else
  {
    SignButton = 0;
    @ENGINE_CONTROL::LeftIndicator = 0;
    @ENGINE_CONTROL::Rightindicator = 0;
    putValue(SignDisplay, "");
    @ENGINE_CONTROL::SpeedGauge = (@ENGINE_CONTROL::AcceleratorTrackbar * (44 * ECmsg.Gear)/8);
    @ENGINE_CONTROL::AccGauge = @ENGINE_CONTROL::AcceleratorTrackbar;
    @ENGINE_CONTROL::Distance += 0.02;
    write("2 block");
  }
  ECmsg.Speed = @ENGINE_CONTROL::SpeedGauge;
  if (ECmsg.Speed > 100)
  {
    @ENGINE_CONTROL::FuelLevel -= 2;
    ECmsg.Fuel = @ENGINE_CONTROL::FuelLevel;
  }  
  else
  {
    @ENGINE_CONTROL::FuelLevel -= 1;
    ECmsg.Fuel = @ENGINE_CONTROL::FuelLevel;
  }  
 }
}

on sysvar ENGINE_CONTROL::FuelLevel
{
  if (@ENGINE_CONTROL::FuelLevel <= 15)
  {
      @ENGINE_CONTROL::FuelLED = 1;
      ECmsg.FuelLED = @ENGINE_CONTROL::FuelLED;
      ECmsg.Fuel = @ENGINE_CONTROL::FuelLevel;
  }
  output(ECmsg);
}

on sysvar ENGINE_CONTROL::BrakeTrackbar
{
  if (button == 0x01)
  {
   
  ECmsg.Brake = @ENGINE_CONTROL::BrakeTrackbar;
  @ENGINE_CONTROL::BrakeGauge = @ENGINE_CONTROL::BrakeTrackbar;
  @ENGINE_CONTROL::SpeedGauge = ECmsg.Speed - ((ECmsg.Speed/5) * ECmsg.Brake);
    if (@ENGINE_CONTROL::GearDisplay != 0)
    {
    @ENGINE_CONTROL::GearDisplay -= 1;
    @ENGINE_CONTROL::GearTrackbar -= 1;    
    }
    @ENGINE_CONTROL::AccGauge = 0;
    @ENGINE_CONTROL::AcceleratorTrackbar = 0;
    ECmsg.Speed = @ENGINE_CONTROL::SpeedGauge;
    output(ECmsg);
  }  
}

on sysvar ENGINE_CONTROL::FillFuelButton
{
  @ENGINE_CONTROL::FuelLevel = 100;
  ECmsg.Fuel = @ENGINE_CONTROL::FuelLevel;
  output(ECmsg);
  @ENGINE_CONTROL::FuelLED = 0;
   putValue(SignDisplay, "");
}

void SetValues(char Sign[], int SpeedSetting, int GearSetting, float DistanceSetting)
{
    putValue(SignDisplay, Sign);
    SetSpeed = SpeedSetting;
    SetGear = GearSetting;
    SetDistance = DistanceSetting;
    SignButton = 1;   
}

on sysvar TRAFFIC_SIGNS::TurnLeft
{
  if (button == 0x01)
  {
    @ENGINE_CONTROL::LeftIndicator = 1;
    SetValues("Turn Left", 20, 1, 0.5);
    TempDistance = @ENGINE_CONTROL::Distance;
    setTimer(delay,10);
  }
}

on sysvar TRAFFIC_SIGNS::TurnRight
{
  if (button == 0x01)
  {
    @ENGINE_CONTROL::Rightindicator = 1;
    SetValues("Turn Right", 15, 1, 0.5);
    TempDistance = @ENGINE_CONTROL::Distance;
    setTimer(delay,10);
  }
}

on sysvar TRAFFIC_SIGNS::AnimalCrossing
{
  if (button == 0x01)
  {
    SetValues("Animal Crossing. Speed Limit: 30 Km/hr", 30, 2, 1.5);
    TempDistance = @ENGINE_CONTROL::Distance;
    setTimer(delay,10);
  }
}

on sysvar TRAFFIC_SIGNS::FuelStation
{
  if (button == 0x01)
  {
    if (@ENGINE_CONTROL::FuelLED == 1) 
    {
      SetValues("Fill Fuel", 0, 0, 0);
      setTimer(delay,10);
    }
  }
}

on sysvar TRAFFIC_SIGNS::TrafficSignal
{
  if (button == 0x01)
  {
    SetValues("Traffic Signal Ahead", 0, 0, 0);
    TempDistance = @ENGINE_CONTROL::Distance;
    setTimer(delay,10);
  }
}

on sysvar TRAFFIC_SIGNS::SchoolZone                                   //system variable for School Zone
{
  if (button == 0x01)                                                  //if schoolzone button is pressed or not
  {
    SetValues("School Zone. Speed Limit: 40 Km/hr", 40, 3, 0.5);      //throws a warning to dashboard,reducing speed to 40km/hr,gear to 3,till distance to 0.5km 
    TempDistance = @ENGINE_CONTROL::Distance;                         // read the current value of distance and store in 'TempDistance' variable
    setTimer(delay,10);                                               //set a timer delay for 10milliseconds
  } 
  
}

on sysvar TRAFFIC_SIGNS::SpeedLimit50                                 //system variable for Speedlimit 50
{
  if (button == 0x01)                                                 //if Speedlimit50 button is pressed or not
  {
    SetValues("Speed Limit: 50 Km/hr", 50, 3, 1);                    //throws a warning to dashboard, reducing speed to 50km/hr,gear to 3 ,till distance to 1km 
    TempDistance = @ENGINE_CONTROL::Distance;                        // read the current value of distance and store in 'TempDistance' variable
    setTimer(delay,10);                                             //set a timer delay for 10 milliseconds
  }
  
}

on sysvar TRAFFIC_SIGNS::SpeedLimit100                            //system variable for Speedlimit 100
{ 
  if (button == 0x01)                                             //if Speedlimit100 button is pressed or not
  {
    SetValues("Speed Limit: 100 Km/hr", 100, 4, 1.5);             //throws a warnig to dashboard,setting the speed limit to 100km/hr,gear to 4, till 1.5km distance
    TempDistance = @ENGINE_CONTROL::Distance;                      //read the current value of distance and store in 'TempDistance' variable
    setTimer(delay,10);                                           //set a timer delay for 10milliseconds
  }  
}

on sysvar TRAFFIC_SIGNS::Gravel                                   //system variable for Gravel
{
  if (button == 0x01)                                             //if gravel button is pressed or not
  {
    SetValues("Gravel Zone. Speed Limit: 10 Km/hr", 10, 1, 0.5);  //throws a waring to dashboard,reducing speed to 10km/hr,gear to 1,till 0.5km distance
    TempDistance = @ENGINE_CONTROL::Distance;                      // read the current value of distance and store in 'TempDistance' variable
    setTimer(delay,10);                                             //set a timer delay for 10milliseconds
  }  
}

on sysvar TRAFFIC_SIGNS::NarrowBridge                               //system variable for NarrowBridge
{
  if (button == 0x01)                                               //if NarrowBridge is pressed or not
  {
    SetValues("Narrow Bridge Ahead", 30, 2, 1);                     //throws a warning to dashboard,reducing speed to 30km/hr,gear to 2,till 1km distance
    TempDistance = @ENGINE_CONTROL::Distance;                        //read the current value of distance and store in 'TempDistance variable
    setTimer(delay,10);                                              //set a timer delay for 10milliseconds
  }  
}

on timer delay
{
  if(SignButton==1)
  {    
    if(@ENGINE_CONTROL::SpeedGauge > SetSpeed)
    {
      @ENGINE_CONTROL::SpeedGauge -= 1;
      ECmsg.Speed = @ENGINE_CONTROL::SpeedGauge;
      output(ECmsg);
      @ENGINE_CONTROL::GearTrackbar = SetGear;     
      setTimer(delay,10);
    }
  }  
}

on stopMeasurement
{
  @ENGINE_CONTROL::StartStopButton = 0;
  @ENGINE_CONTROL::SpeedGauge = 0;
    @ENGINE_CONTROL::AcceleratorTrackbar = 0;
    @ENGINE_CONTROL::AccGauge = 0;
    @ENGINE_CONTROL::BrakeTrackbar = 0;
    @ENGINE_CONTROL::BrakeGauge = 0;
    @ENGINE_CONTROL::GearTrackbar = 0;
    @ENGINE_CONTROL::FuelLED = 0;
    @ENGINE_CONTROL::GearDisplay = 0;
}
