/*@!Encoding:1252*/
includes
{
  
}

variables
{
  message SpeedControl spdcontrol;
  int i,j,x, button,button1;
  msTimer delay;
}

on start{
 //setTimer(delay,1000);
}
on timer delay{
  setTimer(delay,1000);
  if(@SpeedControl::Ignition>0)
  {
  if(button==1)
  {
    setTimer(delay,100);
    if(@SpeedControl::speed>=40)
    {
      @SpeedControl::speed-=20;
    if(@SpeedControl::speed==100)
    {
    @SpeedControl::gear=4;
    }
    if(@SpeedControl::speed==60)
    {
      @SpeedControl::gear=3;
    }
    }
   }
}
}

on sysvar SpeedControl::Ignition
{
  spdcontrol.Ignition=@SpeedControl::Ignition; 
  output(spdcontrol);
}

on sysvar SpeedControl::accelerator
{
  spdcontrol.accelerator=@SpeedControl::accelerator;
  spdcontrol.speed=@SpeedControl::speed;
  spdcontrol.gear=@SpeedControl::gear;
  //EngControl.speed=@EngineControl::speed=@EngineControl::accelerator*27;
  if(@SpeedControl::Ignition>0)
  {
  if(@SpeedControl::gear==1)
  {
   
      if(@SpeedControl::accelerator>2)
      {
        for(i=0;i<=20;i++)
        {
        
         spdcontrol.speed=@SpeedControl::speed=i;
         output(spdcontrol);
        }
      }
      if(@SpeedControl::accelerator<2)
      {
        for(i=20;i>=0;i--)
        {
        
         spdcontrol.speed=@SpeedControl::speed=i;
         output(spdcontrol);
        }
      }
  }
  if(@SpeedControl::gear==2)
  {
    if(@SpeedControl::accelerator>3)
    {
      for(i=21;i<=50;i++)
        {
        spdcontrol.speed=@SpeedControl::speed=i;
        output(spdcontrol);
        }
    }
    if(@SpeedControl::accelerator<3)
    {
      for(i=50;i>=21;i--)
        {
        spdcontrol.speed=@SpeedControl::speed=i;
        output(spdcontrol);
        }
    }
  }
  if(@SpeedControl::gear==3)
  {
    
    if(@SpeedControl::accelerator>3)
    {
      for(i=51;i<=100;i++)
      {
        spdcontrol.speed=@SpeedControl::speed=i;
        output(spdcontrol);
      }
    }
    if(@SpeedControl::accelerator<3)
    {
      for(i=100;i>=51;i--)
      {
        spdcontrol.speed=@SpeedControl::speed=i;
        output(spdcontrol);
      }
    }
  }
  if(@SpeedControl::gear==4)
  {
      if(@SpeedControl::accelerator>3)
      {
        for(i=101;i<=150;i++)
        {
          spdcontrol.speed=@SpeedControl::speed=i;
          output(spdcontrol);
        }
      }
      if(@SpeedControl::accelerator<3)
      {
        for(i=151;i>=100;i--)
        {
          spdcontrol.speed=@SpeedControl::speed=i;
          output(spdcontrol);
        }
      }
    
  }
 if(@SpeedControl::gear==5)
  {
      if(@SpeedControl::accelerator>3)
      {
        for(i=151;i<=220;i++)
        {
          spdcontrol.speed=@SpeedControl::speed=i;
          output(spdcontrol);
        }
      }
      if(@SpeedControl::accelerator<3)
      {
        for(i=220;i>=151;i--)
         { 
          spdcontrol.speed=@SpeedControl::speed=i;
          output(spdcontrol);
        }
      }
  }
  }
}


on sysvar SpeedControl::gear
{
  spdcontrol.gear=@SpeedControl::gear;
  spdcontrol.speed=@SpeedControl::speed;
  spdcontrol.accelerator=@SpeedControl::accelerator;
  output(spdcontrol);
  
}

on sysvar SpeedControl::speed
{
  spdcontrol.gear=@SpeedControl::gear;
  spdcontrol.speed=@SpeedControl::speed;
  spdcontrol.accelerator=@SpeedControl::accelerator;
  output(spdcontrol);

}

on sysvar SpeedControl::schoolzone
{
  spdcontrol.schoolzone=@SpeedControl::schoolzone;
  button = 1; 
  output(spdcontrol);
}

