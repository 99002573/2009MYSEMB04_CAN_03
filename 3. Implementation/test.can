/*@!Encoding:1252*/
includes
{
  
}

variables
{
 
}

MainTest()
{  
//  Testcase_IgnitionON();
//  Testcase_GearTrackbar();
//  TestCase_Speed_GearZERO();
//  Testcase_Fuel1();
//  Testcase_Speed_GearVAL();
//  Testcase_BrakeMIN();
//  Testcase_BrakeMAX();
//  Testcase_Fuel2();
//  Testcase_FillFuel();
  
  Testcase_TrafficSigns();  
}

testcase Testcase_IgnitionON()
{  
  @ENGINE_CONTROL::StartStopButton = 1;
  testWaitForTimeout(500);
  if (getSignal(StartStop) == 1)
  {
    //Test case 1..............when ignition is on, remaining actions should take place
    testStepPass("1.0", "Test case Passed (Ignition key is on)");
  }
  else testStepFail("1.0", "Test case Failed");    
}

testcase Testcase_GearTrackbar()
{
  if (getSignal(StartStop) == 1)
  {
   //Test case 2..............The gear display should show correct Gear values
    @ENGINE_CONTROL::GearTrackbar = 0;
    testWaitForTimeout(500);
    if ( getSignal(Gear) == 0) testStepPass("2.0", "Test case passed..Gear: %.0f", getSignal(Gear));
    else testStepFail("2.0", "Test case Failed..Gear: %d", getSignal(Gear));
    
    @ENGINE_CONTROL::GearTrackbar = 3;
    testWaitForTimeout(500);
    if ( getSignal(Gear) == 3) testStepPass("2.1", "Test case passed..Gear: %.0f", getSignal(Gear));
    else testStepFail("2.1", "Test case Failed..Gear: %d", getSignal(Gear));
    
    @ENGINE_CONTROL::GearTrackbar = 5;
    testWaitForTimeout(500);
    if ( getSignal(Gear) == 5) testStepPass("2.2", "Test case passed..Gear: %.0f", getSignal(Gear));
    else testStepFail("2.2", "Test case Failed..Gear: %d", getSignal(Gear)); 
  }
}

testcase TestCase_Speed_GearZERO()
{
  if (getSignal(StartStop) == 1)
  {
   //Test case 3.............. when gear and acc is 0, speed must be 0
    @ENGINE_CONTROL::GearTrackbar = 0;
    testWaitForTimeout(500);
    @ENGINE_CONTROL::AcceleratorTrackbar = 0;   
    testWaitForTimeout(500);
    if ( getSignal(Speed) == 0) testStepPass("3.0", "Test case passed (when gear and acc is 0, speed must be 0)..Speed: %.0f", getSignal(Speed));
    else testStepFail("3.0", "Test case Failed (when gear and acc is 0, speed must be 0)..Speed: %f", getSignal(Speed));
    
   //Test case 4.............. when gear is 0, Acc is any value, speed must be 0
    @ENGINE_CONTROL::AcceleratorTrackbar = 8;   
    testWaitForTimeout(500);
    if ( getSignal(Speed) == 0) testStepPass("3.0", "Test case passed (when gear is 0, Acc is any value, speed must be 0)..Speed: %.0f", getSignal(Speed));
    else testStepFail("3.1", "Test case Failed (when gear is 0, Acc is any value, speed must be 0)..Speed: %f", getSignal(Speed));
  }
}
 
testcase Testcase_Fuel1()
{
  if (getSignal(StartStop) == 1)
  {
    //Test case 10.............. When speed is greater than 100, fuel must decrease at a rate of 2
    @ENGINE_CONTROL::GearTrackbar = 5;
    testWaitForTimeout(500);
    @ENGINE_CONTROL::AcceleratorTrackbar = 8;
    testWaitForTimeout(500);
    if (getSignal(Fuel) == 99) testStepPass("4.0", "Test case passed (When speed is greater than 100, fuel must decrease at a rate of 2)..Fuel Level: %.0f", getSignal(Fuel));
    else testStepFail("4.0", "Test case Failed (When speed is greater than 100, fuel must decrease at a rate of 2)..Fuel Level: %.0f", getSignal(Fuel));
    
    //Test case 11.............. When speed is greater than 100, fuel must decrease at a rate of 2
    @ENGINE_CONTROL::GearTrackbar = 4;
    testWaitForTimeout(500);
    @ENGINE_CONTROL::AcceleratorTrackbar = 6;
    testWaitForTimeout(500);
    if (getSignal(Fuel) == 97) testStepPass("4.1", "Test case passed (When speed is greater than 100, fuel must decrease at a rate of 2)..Fuel Level: %.0f", getSignal(Fuel));
    else testStepFail("4.1", "Test case Failed (When speed is greater than 100, fuel must decrease at a rate of 2)..Fuel Level: %.0f", getSignal(Fuel));
  }
}

testcase Testcase_Speed_GearVAL()
{
  if (getSignal(StartStop) == 1)
  {
    
    @ENGINE_CONTROL::AcceleratorTrackbar = 0;  // Acc value must change to trigger the sysvar
    
    //Test case 5.............. when gear is 1, the maximum speed is 44    
    @ENGINE_CONTROL::GearTrackbar = 1;
    testWaitForTimeout(500);
    @ENGINE_CONTROL::AcceleratorTrackbar = 8;
    testWaitForTimeout(500);
    if ( getSignal(Speed) == 44) testStepPass("5.0", "Test case passed (when gear is 1, the maximum speed is 44)..Speed: %.0f", getSignal(Speed));
    else testStepFail("5.0", "Test case Failed (when gear is 1, the maximum speed is 44)..Speed: %.0f", getSignal(Speed));
    
    @ENGINE_CONTROL::AcceleratorTrackbar = 0;  
    
     //Test case 5.............. when gear is 1, the maximum speed is 44    
    @ENGINE_CONTROL::GearTrackbar = 2;
    testWaitForTimeout(500);
    @ENGINE_CONTROL::AcceleratorTrackbar = 8;
    testWaitForTimeout(500);
    if ( getSignal(Speed) == 88) testStepPass("5.1", "Test case passed (when gear is 2, the maximum speed is 88)..Speed: %.0f", getSignal(Speed));
    else testStepFail("5.1", "Test case Failed (when gear is 2, the maximum speed is 88)..Speed: %.0f", getSignal(Speed));
    
    @ENGINE_CONTROL::AcceleratorTrackbar = 0;  
      
    //Test case 6.............. when gear is 3, the maximum speed is 132   
    @ENGINE_CONTROL::GearTrackbar = 3;
    testWaitForTimeout(500);
    @ENGINE_CONTROL::AcceleratorTrackbar = 8;
    testWaitForTimeout(500);
    if ( getSignal(Speed) == 132) testStepPass("5.2", "Test case passed (when gear is 3, the maximum speed is 132)..Speed: %.0f", getSignal(Speed));
    else testStepFail("5.2", "Test case Failed (when gear is 3, the maximum speed is 132)..Speed: %.0f", getSignal(Speed));
    
    @ENGINE_CONTROL::AcceleratorTrackbar = 0;  
    
    //Test case 6.............. when gear is 3, the maximum speed is 132   
    @ENGINE_CONTROL::GearTrackbar = 4;
    testWaitForTimeout(500);
    @ENGINE_CONTROL::AcceleratorTrackbar = 8;
    testWaitForTimeout(500);
    if ( getSignal(Speed) == 176) testStepPass("5.3", "Test case passed (when gear is 4, the maximum speed is 176)..Speed: %.0f", getSignal(Speed));
    else testStepFail("5.3", "Test case Failed (when gear is 4, the maximum speed is 176)..Speed: %.0f", getSignal(Speed));
    
    @ENGINE_CONTROL::AcceleratorTrackbar = 0;  
    
   //Test case 7.............. when gear is 5, the maximum speed is 220    
    @ENGINE_CONTROL::GearTrackbar = 5;
    testWaitForTimeout(500);
    @ENGINE_CONTROL::AcceleratorTrackbar = 8;
    testWaitForTimeout(500);
    if ( getSignal(Speed) == 220) testStepPass("5.4", "Test case passed (when gear is 5, the maximum speed is 220)..Speed: %.0f", getSignal(Speed));
    else testStepFail("5.4", "Test case Failed (when gear is 5, the maximum speed is 220)..Speed: %.0f", getSignal(Speed));
  }
}

testcase Testcase_BrakeMIN()
{
  if (getSignal(StartStop) == 1)
  {
    //Test case 8.............. when brake is 0, based on gear and Acc values, the speed is calculated
    @ENGINE_CONTROL::GearTrackbar = 1;
    testWaitForTimeout(500);
    @ENGINE_CONTROL::AcceleratorTrackbar = 5;
    testWaitForTimeout(500);
    @ENGINE_CONTROL::BrakeTrackbar = 0;
    testWaitForTimeout(500);
    if (getSignal(Speed) == _floor(27.5)) testStepPass("6.0", "Test case passed (when brake is 0, based on gear and Acc values, the speed is calculated)..Speed: %.0f", getSignal(Speed));
    else testStepFail("6.0", "Test case Failed (when brake is 0, based on gear and Acc values, the speed is calculated)..Speed: %.0f", getSignal(Speed));
}
}

testcase  Testcase_BrakeMAX()
{
  if (getSignal(StartStop) == 1)
  {
  //Test case 9.............. when brake is 5, gear, Acc and Speed values must be 0
    @ENGINE_CONTROL::GearTrackbar = 2;
    testWaitForTimeout(500);
    @ENGINE_CONTROL::AcceleratorTrackbar = 2;
    testWaitForTimeout(500);
    @ENGINE_CONTROL::BrakeTrackbar = 5;
    testWaitForTimeout(500);
    if (getSignal(Speed) == 0) testStepPass("7.0", "Test case passed (when brake is 5, gear, Acc and Speed values must be 0)..Speed: %.0f", getSignal(Speed));
    else testStepFail("7.0", "Test case Failed (when brake is 5, gear, Acc and Speed values must be 0)..Speed: %.0f", getSignal(Speed));
}
}

testcase Testcase_Fuel2()
{
  if (getSignal(StartStop) == 1)
  {
    //Test case 10.............. When speed is less than 100, fuel must decrease at a rate of 1
    @ENGINE_CONTROL::GearTrackbar = 5;
    testWaitForTimeout(500);
    @ENGINE_CONTROL::AcceleratorTrackbar = 8;
    testWaitForTimeout(500);
    if (getSignal(Fuel) == 79) testStepPass("8.0", "Test case passed (When speed is less than 100, fuel must decrease at a rate of 1)..Fuel Level: %.0f", getSignal(Fuel));
    else testStepFail("8.0", "Test case Failed (When speed is less than 100, fuel must decrease at a rate of 1)..Fuel Level: %f", getSignal(Fuel));
    
    //Test case 11.............. When speed is less than 100, fuel must decrease at a rate of 1
    @ENGINE_CONTROL::GearTrackbar = 2;
    testWaitForTimeout(500);
    @ENGINE_CONTROL::AcceleratorTrackbar = 4;
    testWaitForTimeout(500);
    if (getSignal(Fuel) == 78) testStepPass("8.1", "Test case passed (When speed is less than 100, fuel must decrease at a rate of 1)..Fuel Level: %.0f", getSignal(Fuel));
    else testStepFail("8.1", "Test case Failed (When speed is less than 100, fuel must decrease at a rate of 1)..Fuel Level: %.0f", getSignal(Fuel));
  }
}


testcase Testcase_FillFuel()
{
  if (getSignal(StartStop) == 1)
  {  
    //Test case 12.............. When fill fuel button is pressed, fuel level should reach 100
    @ENGINE_CONTROL::FuelLevel = 10;
    testWaitForTimeout(500);
    if (getSignal(FuelLED) == 1) testStepPass("9.0", "Test case passed (When fuel level is less than 15, Fuel LED is turned on)...Fuel Level: %f", getSignal(Fuel));
    else testStepFail("9.0", "Test case Failed (When fuel level is less than 15, Fuel LED is turned on)..Fuel Level: %f", getSignal(Fuel));
    
   
    //Test case 13.............. When fill fuel button is pressed, fuel level should reach 100
    @ENGINE_CONTROL::FillFuelButton = 1;
    testWaitForTimeout(500);
    if (getSignal(Fuel) == 100) testStepPass("10.0", "Test case passed (When fill fuel button is pressed, fuel level should reach 100)..Fuel Level: %.0f", getSignal(Fuel));
    else testStepFail("10.0", "Test case Failed (When fill fuel button is pressed, fuel level should reach 100)..Fuel Level: %f", getSignal(Fuel));
  }
}

testcase Testcase_TrafficSigns()
{
  if (getSignal(StartStop) == 1)
  {
    @TRAFFIC_SIGNS::TurnLeft = 1;
    testWaitForTimeout(1000);
    if ( getSignal(Speed) >= 0 && getSignal(Speed) <= 20) testStepPass("11.0", "Test case passed (when TurnLeft sign occurs, the speed should gradually reduce to 20 Km/hr)..Speed: %.0f", getSignal(Speed));
    else testStepFail("11.0", "Test case Failed (when TurnLeft sign occurs, the speed should gradually reduce to 20 Km/hr)..Speed: %f", getSignal(Speed));
    
    @TRAFFIC_SIGNS::TurnRight = 1;
    testWaitForTimeout(1000);
    if ( getSignal(Speed) >= 0 && getSignal(Speed) <= 15) testStepPass("11.1", "Test case passed (when TurnRight sign occurs, the speed should gradually reduce to 15 Km/hr)..Speed: %.0f", getSignal(Speed));
    else testStepFail("11.1", "Test case Failed (when TurnRight sign occurs, the speed should gradually reduce to 15 Km/hr)..Speed: %f", getSignal(Speed));
    
    @TRAFFIC_SIGNS::AnimalCrossing = 1;
    testWaitForTimeout(1000);
    if ( getSignal(Speed) >= 0 && getSignal(Speed) <= 30) testStepPass("11.2", "Test case passed (when AnimalCrossing sign occurs, the speed should gradually reduce to 30 Km/hr)..Speed: %.0f", getSignal(Speed));
    else testStepFail("11.2", "Test case Failed (when AnimalCrossing sign occurs, the speed should gradually reduce to 30 Km/hr)..Speed: %f", getSignal(Speed));
    
    @TRAFFIC_SIGNS::FuelStation = 1;
    testWaitForTimeout(1000);
    if ( getSignal(Speed) >= 0 && getSignal(Speed) <= 15) testStepPass("11.3", "Test case passed (when TurnRight sign occurs, the speed should gradually reduce to 15 Km/hr)..Speed: %.0f", getSignal(Speed));
    else testStepFail("11.3", "Test case Failed (when TurnRight sign occurs, the speed should gradually reduce to 15 Km/hr)..Speed: %f", getSignal(Speed));
    
    @TRAFFIC_SIGNS::TrafficSignal = 1;
    testWaitForTimeout(1000);
    if ( getSignal(Speed) == 0) testStepPass("11.4", "Test case passed (when TrafficSignal sign occurs, the speed should gradually reduce to 0 Km/hr)..Speed: %.0f", getSignal(Speed));
    else testStepFail("11.4", "Test case Failed (when TrafficSignal sign occurs, the speed should gradually reduce to 0 Km/hr)..Speed: %f", getSignal(Speed));
    
    @TRAFFIC_SIGNS::SchoolZone = 1;
    testWaitForTimeout(1000);
    if ( getSignal(Speed) >= 0 && getSignal(Speed) <= 40) testStepPass("11.5", "Test case passed (when SchoolZone sign occurs, the speed should gradually reduce to 40 Km/hr)..Speed: %.0f", getSignal(Speed));
    else testStepFail("11.5", "Test case Failed (when SchoolZone sign occurs, the speed should gradually reduce to 40 Km/hr)..Speed: %f", getSignal(Speed));
    
    @TRAFFIC_SIGNS::SpeedLimit50 = 1;
    testWaitForTimeout(1000);
    if ( getSignal(Speed) >= 0 && getSignal(Speed) <= 50) testStepPass("11.6", "Test case passed (when SpeedLimit50 sign occurs, the speed should gradually reduce to 50 Km/hr)..Speed: %.0f", getSignal(Speed));
    else testStepFail("11.6", "Test case Failed (when SpeedLimit50 sign occurs, the speed should gradually reduce to 50 Km/hr)..Speed: %f", getSignal(Speed));
    
    @TRAFFIC_SIGNS::SpeedLimit100 = 1;
    testWaitForTimeout(1000);
    if ( getSignal(Speed) >= 0 && getSignal(Speed) <= 100) testStepPass("11.7", "Test case passed (when SpeedLimit100 sign occurs, the speed should gradually reduce to 100 Km/hr)..Speed: %.0f", getSignal(Speed));
    else testStepFail("11.7", "Test case Failed (when SpeedLimit100 sign occurs, the speed should gradually reduce to 100 Km/hr)..Speed: %f", getSignal(Speed));
    
    @TRAFFIC_SIGNS::Gravel = 1;
    testWaitForTimeout(1000);
    if ( getSignal(Speed) >= 0 && getSignal(Speed) <= 10) testStepPass("11.8", "Test case passed (when Gravel sign occurs, the speed should gradually reduce to 10 Km/hr)..Speed: %.0f", getSignal(Speed));
    else testStepFail("11.8", "Test case Failed (when Gravel sign occurs, the speed should gradually reduce to 10 Km/hr)..Speed: %f", getSignal(Speed));
    
    @TRAFFIC_SIGNS::NarrowBridge = 1;
    testWaitForTimeout(1000);
    if ( getSignal(Speed) >= 0 && getSignal(Speed) <= 30) testStepPass("11.9", "Test case passed (when NarrowBridge sign occurs, the speed should gradually reduce to 30 Km/hr)..Speed: %.0f", getSignal(Speed));
    else testStepFail("11.9", "Test case Failed (when NarrowBridge sign occurs, the speed should gradually reduce to 30 Km/hr)..Speed: %f", getSignal(Speed));
    
  
  
  
  
  
  }
}
